## arch/eco32/Kconfig
```kconfig
config ECO32
    bool
    select OFTREE
    select HAS_CACHE
    select GENERIC_FIND_NEXT_BIT
    select HAVE_CONFIGURABLE_MEMORY_LAYOUT
    select HAVE_CONFIGURABLE_TEXT_BASE
    select CONFIG_OFTREE_MEM_GENERIC
    select ELF
    default y

menu "ECO32 Settings"

config ARCH_TEXT_BASE
    hex "The address barebox gets linked at"
    default 0xC0400000

config BUILTIN_DTB
    bool "Link a DTB into the barebox image"
    depends on OFTREE

choice
    prompt "Select which Bultin DTB to use"
    depends on BUILTIN_DTB

config ECO32SIM_BUILTIN_DTB
    bool "Builtin DTB for the eco32 simulator"

endchoice

config BUILTIN_DTB_NAME
    string
    default "eco32sim" if ECO32SIM_BUILTIN_DTB
    depends on BUILTIN_DTB

choice
    prompt "Select your board"

config GENERIC
    bool "Generic"

endchoice

endmenu

source common/Kconfig
source commands/Kconfig
source net/Kconfig
source drivers/Kconfig
source fs/Kconfig
source lib/Kconfig
source crypto/Kconfig
```

## arch/eco32/configs/sim_defconfig
```kconfig
CONFIG_ARCH_TEXT_BASE=0xC0400000
CONFIG_MEMORY_LAYOUT_FIXED=y
CONFIG_MALLOC_BASE=0xC0500000
CONFIG_MALLOC_SIZE=0x00600000
CONFIG_STACK_BASE=0xC0C00000
CONFIG_BAREBOX_MAX_IMAGE_SIZE=0x00100000
CONFIG_BUILTIN_DTB=y
CONFIG_DEFAULT_ENVIRONMENT_PATH="arch/eco32/boards/generic/env"
CONFIG_PANIC_HANG=y
CONFIG_LONGHELP=y
CONFIG_OFDEVICE=y
CONFIG_OF_BAREBOX_DRIVERS=y
CONFIG_BOOTM_OFTREE
CONFIG_DISK=y
CONFIG_DISK_ECO32=y
# CONFIG_PARTITION_DISK_DOS is not set
CONFIG_PARTITION_DISK_ECO32=y
CONFIG_FS_EXT4=y
# CONFIG_SPI is not set
# CONFIG_PINCTRL is not set
CONFIG_CMD_EXPORT=y
CONFIG_CMD_OFTREE=y
CONFIG_CMD_OF_DUMP=y
```

## drivers/block/Kconfig
```kconfig
if DISK

menu "Simple Block Devices"

config DISK_ECO32
	bool "eco32 disk driver"
	depends on ECO32
	help
	  select this to enable support for the eco32 disk

endmenu

endif
```
